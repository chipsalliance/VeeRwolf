## west.yml
```yaml
manifest:
  remotes:
    - name: zephyrproject-rtos
      url-base: https://github.com/zephyrproject-rtos
  projects:
    - name: zephyr
      remote: zephyrproject-rtos
      revision: v2.7.4
      import: true
```

## zephyr/Kconfig
```kconfig
# Copyright (c) 2020 Olof Kindgren <olof.kindgren@gmail.com>
#
# SPDX-License-Identifier: Apache-2.0

menu "VeeRwolf"

rsource "drivers/Kconfig"

endmenu
```

## zephyr/boards/riscv/swervolf_nexys/Kconfig.board
```kconfig
config BOARD_SWERVOLF_NEXYS
	bool "SweRVolf for Nexys A7"
	depends on SOC_RISCV32_SWERVOLF
```

## zephyr/boards/riscv/swervolf_nexys/Kconfig.defconfig
```kconfig
config BOARD
	default "swervolf_nexys"
	depends on BOARD_SWERVOLF_NEXYS
if FLASH

config SPI_NOR
	def_bool y

endif
```

## zephyr/boards/riscv/swervolf_nexys/swervolf_nexys_defconfig
```kconfig
#
# Copyright (c) 2020 Olof Kindgren <olof.kindgren@gmail.com>
#
# SPDX-License-Identifier: Apache-2.0
#

CONFIG_SOC_RISCV32_SWERVOLF=y
CONFIG_BOARD_SWERVOLF_NEXYS=y
CONFIG_CONSOLE=y
CONFIG_SERIAL=y

CONFIG_GPIO_SWERVOLF=y
CONFIG_UART_CONSOLE=y
CONFIG_UART_CONSOLE_ON_DEV_NAME="uart0"
CONFIG_PLIC=n
CONFIG_XIP=n
CONFIG_BOOT_BANNER=y
CONFIG_SYS_CLOCK_TICKS_PER_SEC=100
```

## zephyr/boards/riscv/veerwolf_nexys/Kconfig.board
```kconfig
config BOARD_VEERWOLF_NEXYS
	bool "VeeRwolf for Nexys A7"
	depends on SOC_RISCV32_VEERWOLF
```

## zephyr/boards/riscv/veerwolf_nexys/Kconfig.defconfig
```kconfig
config BOARD
	default "veerwolf_nexys"
	depends on BOARD_VEERWOLF_NEXYS
if FLASH

config SPI_NOR
	def_bool y

endif
```

## zephyr/boards/riscv/veerwolf_nexys/veerwolf_nexys_defconfig
```kconfig
#
# Copyright (c) 2020 Olof Kindgren <olof.kindgren@gmail.com>
#
# SPDX-License-Identifier: Apache-2.0
#

CONFIG_SOC_RISCV32_VEERWOLF=y
CONFIG_BOARD_VEERWOLF_NEXYS=y
CONFIG_CONSOLE=y
CONFIG_SERIAL=y

CONFIG_GPIO_VEERWOLF=y
CONFIG_UART_CONSOLE=y
CONFIG_PLIC=n
CONFIG_XIP=n
CONFIG_BOOT_BANNER=y
CONFIG_SYS_CLOCK_TICKS_PER_SEC=100
```

## zephyr/boards/riscv32/swervolf_nexys/swervolf_nexys_defconfig
```kconfig
CONFIG_RISCV32=y
CONFIG_SOC_SERIES_RISCV32_SWERV=y
CONFIG_SOC_RISCV32_SWERVOLF=y
CONFIG_BOARD_SWERVOLF_NEXYS=y
CONFIG_CONSOLE=y
CONFIG_SERIAL=y

CONFIG_UART_CONSOLE=y
CONFIG_UART_CONSOLE_ON_DEV_NAME="uart0"
CONFIG_PLIC=n
CONFIG_XIP=n
CONFIG_BOOT_BANNER=y
```

## zephyr/drivers/gpio/Kconfig
```kconfig
# VeeRwolf GPIO configuration options

# Copyright (c) 2020 Olof Kindgren <olof.kindgren@gmail.com>
# SPDX-License-Identifier: Apache-2.0

config GPIO_VEERWOLF
	bool "VeeRwolf GPIO driver"
	select GPIO
	depends on SOC_RISCV32_VEERWOLF
	help
	  Enable VeeRwolf GPIO driver.
```

## zephyr/dts/bindings/gpio/veerwolf,gpio.yaml
```yaml
#
# Copyright (c) 2020 Olof Kindgren <olof.kindgren@gmail.com>
#
# SPDX-License-Identifier: Apache-2.0
#

description: SweRVolf GPIO

compatible: "swervolf,gpio"

include: [gpio-controller.yaml, base.yaml]

properties:
    reg:
      required: true

    label:
      required: true

    ngpios:
      required: true

    "#gpio-cells":
      const: 2

gpio-cells:
  - pin
  - flags
```

## zephyr/soc/riscv/swervolf/Kconfig.soc
```kconfig
config SOC_RISCV32_SWERVOLF
	bool "SweRVolf - SweRV EH1-based SoC"
	select ATOMIC_OPERATIONS_C
```

## zephyr/soc/riscv/veerwolf/Kconfig.defconfig
```kconfig
if SOC_RISCV32_SWERVOLF

config SOC
	def_string "swervolf"

#Not used but must be defined
config SYS_CLOCK_HW_CYCLES_PER_SEC
	def_int 50000000

config TIMER_READS_ITS_FREQUENCY_AT_RUNTIME
       def_bool y

config RISCV_SOC_INTERRUPT_INIT
	def_bool y

config RISCV_HAS_CPU_IDLE
	def_bool n

config RISCV_HAS_PLIC
	def_bool n

config SWERV_PIC
	def_bool y

config NUM_IRQS
	def_int 64

if SERIAL

config UART_NS16550
	def_bool y

config UART_NS16550_PORT_0
	def_bool y

endif # SERIAL

if GPIO

config GPIO_MMIO32
	def_bool y

endif # GPIO

if SPI

config SPI_OC_SIMPLE
	def_bool y

config SPI_OC_SIMPLE_BUS_WIDTH
	def_int 64

endif # SPI

config XIP
	def_bool n

config RISCV_MACHINE_TIMER
	def_bool y

config RISCV_ROM_BASE_ADDR
	def_hex 0x00000000

config RISCV_ROM_SIZE
	def_hex 0x0

endif # SOC_RISCV32_SWERVOLF
```

## zephyr/soc/riscv/veerwolf/Kconfig.soc
```kconfig
config SOC_RISCV32_VEERWOLF
	bool "VeeRwolf - VeeR EH1-based SoC"
	select RISCV
	select ATOMIC_OPERATIONS_C
```

## zephyr/soc/riscv32/riscv-privilege/swerv/Kconfig.defconfig.series
```kconfig
if SOC_SERIES_RISCV32_SWERV

config SOC_SERIES
	string
	default "swerv"

config SYS_CLOCK_HW_CYCLES_PER_SEC
	int
	default 25000000

config RISCV_SOC_INTERRUPT_INIT
	bool
	default y

config RISCV_HAS_CPU_IDLE
	bool
	default n

config RISCV_HAS_PLIC
	bool
	default n

config NUM_IRQS
	int
	default 8

if SERIAL

config UART_NS16550
	def_bool y

config UART_NS16550_PORT_0
	def_bool y
endif # SERIAL

if GPIO

config GPIO_MMIO32
	def_bool y

endif # GPIO

config XIP
	bool
	default n


config RISCV_MACHINE_TIMER
	bool
	default y

config RISCV_ROM_BASE_ADDR
	hex
	default 0x00000000

config RISCV_ROM_SIZE
	hex
	default 0x0

endif # SOC_SERIES_RISCV32_SWERV
```

## zephyr/soc/riscv32/riscv-privilege/swerv/Kconfig.series
```kconfig
config SOC_SERIES_RISCV32_SWERV
	bool "SWerVolf - SweRV EH1-based SoC"
	depends on RISCV32
	select GPIO_MMIO32 if GPIO
	select SOC_FAMILY_RISCV_PRIVILEGE
	help
	Enable support for SweRV
```

## zephyr/soc/riscv32/riscv-privilege/swerv/Kconfig.soc
```kconfig
choice
prompt "SweRVolf - SweRV EH1-based SoC"
depends on SOC_SERIES_RISCV32_SWERV

config SOC_RISCV32_SWERVOLF
	bool "SWERVOLF"
	select ATOMIC_OPERATIONS_C

endchoice
```
